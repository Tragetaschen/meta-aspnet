## conf/layer.conf
```bitbake
# We have a conf and classes directory, add to BBPATH
BBPATH .= ":${LAYERDIR}"

# We have recipes-* directories, add to BBFILES
BBFILES += "${LAYERDIR}/recipes-*/*/*.bb \
	${LAYERDIR}/recipes-*/*/*.bbappend"

BBFILE_COLLECTIONS += "aspnet"
BBFILE_PATTERN_aspnet = "^${LAYERDIR}/"
BBFILE_PRIORITY_aspnet = ""

LAYERSERIES_COMPAT_aspnet = "thud warrior"

HOSTTOOLS += "dotnet"
```
